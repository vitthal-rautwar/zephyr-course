## CMakeLists.txt
```
cmake_minimum_required(VERSION 3.20.0)

list(APPEND BOARD_ROOT ${CMAKE_CURRENT_SOURCE_DIR})

find_package(Zephyr REQUIRED HINTS $ENV{ZEPHYR_BASE})
project(driver_sens1)
target_sources(app PRIVATE 
    src/main.c
    drivers/our_driver/our_driver.c
)
target_sources_ifdef(CONFIG_SHELL app PRIVATE drivers/our_driver/driver_shell.c)
```

## prj.conf
```kconfig
CONFIG_STDOUT_CONSOLE=y
CONFIG_PRINTK=n
CONFIG_GPIO=y
CONFIG_SENSOR=y
CONFIG_OUR_DRIVER=y
CONFIG_SENSOR_LOG_LEVEL_DBG=y
CONFIG_SHELL=y
CONFIG_SHELL_BACKEND_SERIAL=y
```

## src/main.c
```c
#include <zephyr/kernel.h>
#include <zephyr/device.h>
#include <zephyr/drivers/sensor.h>
#include <zephyr/sys/printk.h>

int main(void)
{
    const struct device *dev = DEVICE_DT_GET(DT_NODELABEL(our_sensor));
    struct sensor_value val;

    if (!device_is_ready(dev)) {
        printk("Sensor device not ready\n");
        return 0;
    }

    while (1) {
        printk("Fetching sample (LED ON)...\n");
        sensor_sample_fetch(dev);
        k_msleep(2000);

        printk("Getting channel (LED OFF)...\n");
        sensor_channel_get(dev, SENSOR_CHAN_ALL, &val);
        k_msleep(2000);
    }

    return 0;
}
```
