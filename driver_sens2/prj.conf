## CMakeLists.txt
```
cmake_minimum_required(VERSION 3.20.0)

list(APPEND BOARD_ROOT ${CMAKE_CURRENT_SOURCE_DIR})

find_package(Zephyr REQUIRED HINTS $ENV{ZEPHYR_BASE})
project(driver_sens2)

target_include_directories(app PRIVATE drivers/our_driver)

target_sources(app PRIVATE 
    src/main.c
    drivers/our_driver/our_driver.c
)

target_sources_ifdef(CONFIG_SHELL app PRIVATE drivers/our_driver/driver_shell.c)
```

## Kconfig
```
mainmenu "Custom Driver Application"

rsource "drivers/our_driver/Kconfig"

source "Kconfig.zephyr"
```

## prj.conf
```kconfig
CONFIG_STDOUT_CONSOLE=y
CONFIG_PRINTK=y
CONFIG_GPIO=y
CONFIG_SENSOR=y
CONFIG_OUR_DRIVER=y
CONFIG_SENSOR_LOG_LEVEL_DBG=y
CONFIG_SHELL=y
CONFIG_SHELL_BACKEND_SERIAL=y
```

## app.overlay
```dts
/ {
    our_sensor: our_sensor_node {
        compatible = "our,driver";
        led-gpios = <&gpio0 2 GPIO_ACTIVE_HIGH>;
        status = "okay";
    };
};
```

## dts/bindings/our,driver.yaml
```yaml
description: Custom LED Sensor Driver

compatible: "our,driver"

include: [sensor-device.yaml, base.yaml]

properties:
  led-gpios:
    type: phandle-array
    required: true
    description: GPIO pin connected to the LED
```

## src/main.c
```c
#include <zephyr/kernel.h>
#include <zephyr/device.h>
#include <zephyr/drivers/sensor.h>
#include <zephyr/sys/printk.h>
#include "our_driver.h"

int main(void)
{
    const struct device *dev = DEVICE_DT_GET(DT_NODELABEL(our_sensor));
    struct sensor_value val;
    uint32_t new_param_value = 500;

    if (!device_is_ready(dev)) {
        printk("Sensor device not ready\n");
        return 0;
    }

    printk("Testing custom extension API function...\n");

    /* Call custom extension API to alter driver dynamic data */
    our_driver_set_custom_param(dev, new_param_value);

    while (1) {
        printk("Fetching sample (LED ON)...\n");
        sensor_sample_fetch(dev);
        k_msleep(500);

        printk("Getting channel (LED OFF)...\n");
        sensor_channel_get(dev, SENSOR_CHAN_ALL, &val);
        printk("Retrieved custom_param via sensor_channel_get: %d\n", val.val1);
        k_msleep(500);
    }

    return 0;
}
```
