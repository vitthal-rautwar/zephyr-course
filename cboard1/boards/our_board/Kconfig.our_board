## cboard1/boards/our_board/Kconfig.our_board
```kconfig
# Copyright (c) 2025 Siratul Islam
# SPDX-License-Identifier: Apache-2.0

config BOARD_OUR_BOARD
	select SOC_ESP32_WROOM_32UE_N4
	select SOC_ESP32_PROCPU if BOARD_OUR_BOARD
	select SOC_ESP32_APPCPU if BOARD_OUR_BOARD
```

## cboard1/boards/our_board/board.yml
```yaml
board:
  name: our_board
  full_name: Our Custom Board
  vendor: others
  socs:
    - name: esp32
```

## cboard2/boards/my_board/Kconfig.my_board
```kconfig
# Copyright (c) 2025 Siratul Islam
# SPDX-License-Identifier: Apache-2.0

config BOARD_MY_BOARD
        select SOC_ESP32_WROOM_32UE_N4
        select SOC_ESP32_PROCPU if BOARD_MY_BOARD_ESP32_PROCPU
        select SOC_ESP32_APPCPU if BOARD_MY_BOARD_ESP32_APPCPU
```

## cboard2/boards/my_board/board.yml
```yaml
board:
  name: my_board
  full_name: My Custom Board
  vendor: custom
  socs:
    - name: esp32
```

## deviceTree_Demo/kconfig
```kconfig
mainmenu "Blinky Configuration"

config APP_HEARTBEAT_PERIOD_MS
    int "Heartbeat LED Period (ms)"
    default 500
    range 100 2000
    help
      Sets the sleep duration for the heartbeat LED.

source "Kconfig.zephyr"
```

## driver_sens2/drivers/our_driver/Kconfig
```kconfig
config OUR_DRIVER
    bool "Custom LED Sensor Driver"
    default y
    depends on SENSOR
    depends on GPIO
    help
      Enable custom LED driver using sensor API.
```

## l3_task1/Kconfig
```kconfig
# Import standard Zephyr Kconfig tree from the Zephyr repository root
osource "$ZEPHYR_BASE/Kconfig.zephyr"

menuconfig LED_SUBSYSTEM
    bool "LED Subsystem"
    default y

if LED_SUBSYSTEM

choice LED_BLINK_SLEEP_TIME
    prompt "LED blink sleep time"
    default LED_BLINK_MEDIUM

config LED_BLINK_FAST
    bool "500ms (fast)"

config LED_BLINK_MEDIUM
    bool "1s (medium)"

config LED_BLINK_SLOW
    bool "2s (slow)"

endchoice

# Hidden int symbol deriving its numeric millisecond value from the choice
config LED_BLINK_SLEEP_TIME_MS
    int
    default 500 if LED_BLINK_FAST
    default 1000 if LED_BLINK_MEDIUM
    default 2000 if LED_BLINK_SLOW

menuconfig ADVANCED_LED_SETTINGS
    bool "Advanced LED settings"

if ADVANCED_LED_SETTINGS

config LED_BRIGHTNESS
    int "LED brightness (0-100)"
    range 0 100
    default 100

config LED_FADE_DURATION
    int "LED fade duration (ms)"
    range 0 5000
    default 500

menu "Expert settings"

config LED_DEBUG
    bool "Enable LED debugging"

config LED_CUSTOM_BLINK
    bool "Custom blink pattern"

endmenu

endif # ADVANCED_LED_SETTINGS

endif # LED_SUBSYSTEM
```
